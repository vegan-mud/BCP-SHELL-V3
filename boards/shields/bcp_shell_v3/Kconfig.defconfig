## boards/shields/bcp_shell_v3/Kconfig.defconfig
```kconfig
if SHIELD_BCP_SHELL_V3_DONGLE

# Name must be less than 16 characters long!
config ZMK_KEYBOARD_NAME
    default "BCP-SHELL-V3"

config ZMK_SPLIT_ROLE_CENTRAL
    default y

config ZMK_SPLIT_BLE_CENTRAL_PERIPHERALS
  default 2

config BT_MAX_CONN
  default 7

config BT_MAX_PAIRED
  default 7

endif

if SHIELD_BCP_SHELL_V3_DONGLE || SHIELD_BCP_SHELL_V3_LEFT || SHIELD_BCP_SHELL_V3_RIGHT

config ZMK_SPLIT
    default y

endif

# ---------------------
# Kconfig for shield "bcp_shell_v3_dongle" with board "nice_nano_v2"
# ---------------------
if BOARD_NICE_NANO_V2 && SHIELD_BCP_SHELL_V3_DONGLE

config SPI
    default y

endif
```

## boards/shields/bcp_shell_v3/Kconfig.shield
```kconfig
config SHIELD_BCP_SHELL_V3_DONGLE
    def_bool $(shields_list_contains,bcp_shell_v3_dongle)
  
config SHIELD_BCP_SHELL_V3_LEFT
    def_bool $(shields_list_contains,bcp_shell_v3_left)
  
config SHIELD_BCP_SHELL_V3_RIGHT
    def_bool $(shields_list_contains,bcp_shell_v3_right)
  
```
